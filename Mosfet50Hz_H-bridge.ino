#include <stdint.h>

int8_t pwm = 1;

#define PUSHPULL_DRIVE_1 33
#define PUSHPULL_DRIVE_2 25
#define SELF_TRIGGERING_IRQ 0
#define DRIVE1_PWM 1
#define DRIVE2_PWM 2
#define CYCLE_START_PIN 35 //pin connected to the optocoupler that detects the zero crossing of the mains sine wave
#define INPUT_ZCD 34 //pin connected to the optocoupler that detects the zero crossing of the mains sine wave
#define OUTPUT_PIN 27 //pin connected to 35

const byte  led_gpio    =   32;
int32_t PWM_FEEDBACK_PIN = 18;
int phaseOffset = 25; // 25 degrees phase offset

#define MODULATING_FREQ         18002   // <-- 18KHz is 360 x 50 Hz for American 60Hz use number 21600 instead
#define MAX_STEPS               360     //  one pwm update per degree of mains sine
#define TRANSISTOR_SWITCH_STEP  179     // when to use other transistor bank

int32_t sinetable[]= 
{
0 ,
4 ,
8 ,
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5 ,
1
};

int32_t ctr = 0;

void isr(){

    int32_t val; // get value from sinetable

int index = (ctr + phaseOffset) % MAX_STEPS; // scale the sine tablkee and apply offset
 val = sinetable[index]; // get value from sinetable
   
    if(index>TRANSISTOR_SWITCH_STEP) // if we are past the TRANSISTOR_SWITCH_STEP
    {
        ledcWrite(DRIVE1_PWM, 0); // turn off transistor bank 1
        ledcWrite(DRIVE2_PWM, val); // turn on transistor bank 2
    }
    else
    {
        ledcWrite(DRIVE1_PWM, val); // turn on transistor bank 1
        ledcWrite(DRIVE2_PWM, 0); // turn off transistor bank 2
    }

    ctr++; // increment counter
    if (ctr >= MAX_STEPS) ctr = 0; // reset counter if we are at the end of the sinetable
}

void cycle_start_isr(){
    ctr = 0; // reset counter when a zero crossing is detected
}


void setup() {
    ledcSetup(SELF_TRIGGERING_IRQ, MODULATING_FREQ, 8); // 8 bit resolution
    ledcSetup(DRIVE1_PWM, MODULATING_FREQ, 8); // 8 bit resolution
    ledcSetup(DRIVE2_PWM, MODULATING_FREQ, 8); // 8 bit resolution

    ledcAttachPin(led_gpio, SELF_TRIGGERING_IRQ);
    ledcAttachPin(PUSHPULL_DRIVE_1, DRIVE1_PWM);
    ledcAttachPin(PUSHPULL_DRIVE_2, DRIVE2_PWM);

    pinMode(PWM_FEEDBACK_PIN, INPUT_PULLDOWN);
    attachInterrupt(CYCLE_START_PIN, cycle_start_isr, RISING); //triggers cycle_start_isr function when a rising edge is detected in the cycle start pin
    attachInterrupt(PWM_FEEDBACK_PIN, isr, RISING); //triggers isr function when a rising edge is detected in the PWM feedback pin
    

    ledcWrite(SELF_TRIGGERING_IRQ, pwm); //Means that pin 18 is basicly a clock pin at frequency MODULATING_FREQ (18KHz)
    ledcWrite(DRIVE1_PWM, 127);
    ledcWrite(DRIVE2_PWM, 127);
    pinMode(INPUT_ZCD,INPUT);
    pinMode(OUTPUT_PIN,OUTPUT);
    Serial.begin(115200);
}

void loop() {
    if(analogRead(INPUT_ZCD)>4000){
        digitalWrite(OUTPUT_PIN, HIGH);
    }
    else{
        digitalWrite(OUTPUT_PIN, LOW);
    }
}